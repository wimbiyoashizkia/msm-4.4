## drivers/block/vbswap/Kconfig
```kconfig
config VBSWAP
	tristate "Fake block device for swap based"
	depends on BLOCK && ZSWAP
	default n
```

## drivers/input/touchscreen/nt36xxx/Kconfig
```kconfig
#
# Novatek NT36XXX touchscreen driver configuration
#
config TOUCHSCREEN_NT36XXX
	bool "Novatek NT36XXX"
	default n
	help
	  Say Y here if you have a Novatek NT36XXX touchscreen connected
	  to your system.

	  If unsure, say N.
```
